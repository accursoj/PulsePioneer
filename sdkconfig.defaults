## sdkconfig.defaults
```kconfig
# -------------------------------
# Flash configuration
# -------------------------------
CONFIG_ESPTOOLPY_FLASHMODE_OPI=y
CONFIG_ESPTOOLPY_FLASHFREQ_80M=y
CONFIG_ESPTOOLPY_FLASHSIZE_32MB=y

# -------------------------------
# PSRAM (16MB Octal)
# -------------------------------
CONFIG_SPIRAM=y
CONFIG_SPIRAM_MODE_OCT=y
CONFIG_SPIRAM_SIZE=16384
CONFIG_SPIRAM_BOOT_INIT=y
CONFIG_SPIRAM_USE_MALLOC=y
CONFIG_SPIRAM_MALLOC_ALWAYSINTERNAL=16384

# -------------------------------
# Memory optimization
# -------------------------------
CONFIG_HEAP_POISONING_DISABLED=y
CONFIG_ESP32S3_DATA_CACHE_LINE_64B=y
```
